#include "stm32f10x.h" 
#include "AHT20-21_DEMO_V1_3.h" 
#include "delay.h"
#include "sys.h"
#include "oled.h"
#include "gui.h"
int32_t main(void)
{
	delay_init();	    	       //延时函数初始化	  
	NVIC_Configuration(); 	   //设置NVIC中断分组2:2位抢占优先级，2位响应优先级 	
	OLED_Init();			         //初始化OLED  
	OLED_Clear(0);             //清屏（全黑）
    uint32_t CT_data[2];
	volatile int  c1,t1;
	/***********************************************************************************/
	/**///上电初始化SDA，SCL的IO口
	/***********************************************************************************/
	Init_I2C_Sensor_Port();
	/***********************************************************************************/
	/**///①刚上电，产品芯片内部就绪需要时间，延时100~500ms,建议500ms
	/***********************************************************************************/
	Delay_1ms(500);
	/***********************************************************************************/
	/**///②上电第一次发0x71读取状态字，判断状态字是否为0x18,如果不是0x18,进行寄存器初始化
	/***********************************************************************************/
	if((AHT20_Read_Status()&0x18)!=0x18)
	{
	AHT20_Start_Init(); //重新初始化寄存器
	Delay_1ms(10);
	}
	
	/***********************************************************************************/
	/**///③根据客户自己需求发测量命令读取温湿度数据，当前while（1）循环发测量命令读取温湿度数据，仅供参考
	/***********************************************************************************/
	while(1)
	{
	 AHT20_Read_CTdata_crc(CT_data);       //不经过CRC校验，直接读取AHT20的温度和湿度数据    推荐每隔大于1S读一次
    //AHT20_Read_CTdata_crc(CT_data);  //crc校验后，读取AHT20的温度和湿度数据 
	 if(CT_data[0]==0xff&&CT_data[1]==0xff){
			OLED_Clear(0);
			GUI_ShowCHinese(0,0,16,"检验错误",1);
	 }
	 else{
			c1 = CT_data[0]*100*10/1024/1024;  //计算得到湿度值c1（放大了10倍）
			t1 = CT_data[1]*200*10/1024/1024-500;//计算得到温度值t1（放大了10倍）
	////下一步客户处理显示数据，
		 uint8_t c2 = c1%10;
		 c1 /= 10;
		 uint8_t t2 = t1%10;
		 t1 /= 10;
		  OLED_Clear(0);
		 GUI_ShowCHinese(0,16,16,"温度",1);
		 GUI_ShowChar(32,16,':',16,1);
			GUI_ShowNum(48,16,t1,2,16,1);
		 GUI_ShowChar(64,16,'.',16,1);
		 GUI_ShowNum(80,16,t2,1,16,1);
		 		 GUI_ShowCHinese(0,32,16,"湿度",1);
		 GUI_ShowChar(32,32,':',16,1);
			GUI_ShowNum(48,32,c1,2,16,1);
		 GUI_ShowChar(64,32,'.',16,1);
		 GUI_ShowNum(80,32,c2,1,16,1);
	 }

	 Delay_1ms(2000);
	 }

 }	